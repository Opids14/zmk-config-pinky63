## config/boards/shields/pinky63/Kconfig.defconfig
```kconfig
# Copyright (c) 2020 The ZMK Contributors
# SPDX-License-Identifier: MIT

if SHIELD_PINKY63

config ZMK_KEYBOARD_NAME
    default "Pinky63"

endif
```

## config/boards/shields/pinky63/Kconfig.shield
```kconfig
# Copyright (c) 2020 The ZMK Contributors
# SPDX-License-Identifier: MIT

config SHIELD_PINKY63
    def_bool $(shields_list_contains,pinky63)
```
